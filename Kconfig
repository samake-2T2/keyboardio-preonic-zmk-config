## Kconfig
```kconfig
# Kconfig for Keyboardio Preonic Module

menuconfig KEYBOARDIO_BUTTERFLY_STATUS
	bool "Keyboardio Butterfly Status Indicator"
	default y
	depends on ZMK_BLE
	select LED_STRIP
	help
	  Enables dedicated Bluetooth profile and connection status indication
	  on the 4 butterfly wing RGB LEDs (SK6812/WS2812).

if KEYBOARDIO_BUTTERFLY_STATUS

config BUTTERFLY_BRIGHTNESS
	int "Active LED brightness (1-255)"
	default 120
	range 1 255
	help
	  Brightness when a wing LED is actively indicating or blinking.

config BUTTERFLY_DIM_BRIGHTNESS
	int "Dimmed LED brightness (0-255)"
	default 20
	range 0 255
	help
	  Dimmed brightness for connected profile after timeout (0 for completely off).

config BUTTERFLY_BLINK_MS
	int "Blink interval when pairing/advertising (milliseconds)"
	default 400
	help
	  Interval in milliseconds between blink transitions during advertising.

config BUTTERFLY_TIMEOUT_MS
	int "Connected indicator full-brightness duration (milliseconds)"
	default 5000
	help
	  Duration before the connected wing dims to save battery.

config BUTTERFLY_BOOT_ANIM_MS
	int "Boot breathing animation duration (milliseconds, 0 to disable)"
	default 1600
	range 0 10000
	help
	  Duration of the warm amber breathing animation on the 4 butterfly LEDs upon boot.

choice BUTTERFLY_USB_COLOR
	prompt "USB mode indicator LED color"
	default BUTTERFLY_USB_COLOR_WHITE
	help
	  Select the LED color used when connected or outputting via USB.

config BUTTERFLY_USB_COLOR_WHITE
	bool "Clean White"
	help
	  Clean White color for USB mode (R=brt, G=brt, B=brt). Distinct from green battery.

config BUTTERFLY_USB_COLOR_PURPLE
	bool "Purple / Magenta"
	help
	  Purple color for USB mode (R=0.8*brt, G=0, B=brt).

config BUTTERFLY_USB_COLOR_CYAN
	bool "Cyan / Ice Blue"
	help
	  Cyan color for USB mode (R=0, G=brt, B=brt).

endchoice

endif # KEYBOARDIO_BUTTERFLY_STATUS

menuconfig KEYBOARDIO_PREONIC_SOUND
	bool "Keyboardio Preonic Piezo Sound Support"
	default y
	depends on PWM
	help
	  Enables piezo buzzer sound effects including Super Mario coin boot greeting
	  and audio clicky on key press.

if KEYBOARDIO_PREONIC_SOUND

config PREONIC_SOUND_MASTER_DEFAULT
	bool "Master sound enabled by default on boot"
	default y
	help
	  Master switch for all piezo sound effects. Can be toggled with Fn + S.

config PREONIC_SOUND_CLICKY_DEFAULT
	bool "Audio clicky enabled by default on boot"
	default y
	help
	  Whether audio clicky is active upon startup. Can be toggled with Fn + C.

config PREONIC_SOUND_COIN_BOOT
	bool "Play Super Mario coin sound on boot"
	default y
	help
	  Play Super Mario coin sound on cold boot/startup.

config PREONIC_SOUND_CLICK_FREQ
	int "Clicky tone frequency in Hz"
	default 3000
	range 500 10000
	help
	  Frequency of the short click pulse.

config PREONIC_SOUND_CLICK_DURATION_MS
	int "Clicky tone duration in ms"
	default 5
	range 1 50
	help
	  Duration of the click pulse in milliseconds.

endif # KEYBOARDIO_PREONIC_SOUND
```
